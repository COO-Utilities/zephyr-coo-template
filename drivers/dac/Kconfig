## drivers/dac/tps55287q1/Kconfig
```kconfig
config TPS55287Q1
    bool "TPS55287-Q1 36V, 4A Buck-Boost Converter"
    default n
    depends on I2C
    help
        Enable driver for the TPS55287-Q1 36V, 4A Buck-Boost Converter. This driver depends on the I2C subsystem being enabled.

if TPS55287Q1

config TPS55287Q1_INIT_PRIORITY
	int "Init priority"
	default 80
	help
	  TI TPS55287Q1 device driver initialization priority. It needs to be greater than CONFIG_I2C_INIT_PRIORITY = 60.

endif # TPS55287Q1
```

## dts/bindings/dac/ti,tps55287q1.yaml
```yaml
description: TI TPS55287-Q1 36V, 4A Buck-Boost Converter
compatible: ti,tps55287q1
include: [dac-controller.yaml, i2c-device.yaml]
```
